; *************************************************************
; *** Scatter-Loading Description File generated by uVision ***
; *************************************************************

LR_IROM1 0x00000000 0x00080000  {    ; load region size_region
  ER_IROM1 0x00000000 0x00080000  {  ; load address = execution address
   *.o (RESET, +First)
   *(InRoot$$Sections)
   .ANY (+RO)
   .ANY (+XO)
  }
  RW_IRAM1 0x20000000 0x00010000  {  ; RW data
   .ANY (+RW +ZI)
  }
  ER_SDRAM1 0x80000000 0x00300000  {             ; execution address
    *(.SDRAM1)
  }
}

LR_SPIFLASH 0x70000000 0x00500000  {      ; load region size_region
  ER_SDRAM2 0x80300000 0x00500000  {             ; execution address
  app_test.o
  encoder.o
  remote.o
  USB.o
  COA.o
  HDMI.o
  TOS.o
  XIEBIAN.o
  back.o
  back_p.o
  next.o
  USB3.o
  COA3.o
  HDMI3.o
  TOS3.o
  ENTER3.o
  blmax.o
  blmin.o
  BL0.o
  BL1.o
  BL2.o
  BL3.o
  BL4.o
  BL5.o
  BL6.o
  BL7.o
  BL8.o
  jfu.o
  j0.o
  j1.o
  j2.o
  j3.o
  j4.o
  j5.o
  j6.o
  j7.o
  j8.o
  j9.o
  lv_font_msyh_23_num.o
  lv_font_simhei_25_num.o
  lv_font_palatino_25_num.o
  lv_font_palatino_27_num.o
  lv_font_palatino_29_num.o
  lv_font_palatino_39_num.o
  lv_font_palatino_40_num.o
  lv_font_palatino_68_num.o
  }
}
